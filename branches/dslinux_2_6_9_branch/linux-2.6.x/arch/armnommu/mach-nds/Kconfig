## branches/dslinux_2_6_9_branch/linux-2.6.x/arch/armnommu/mach-nds/Kconfig
```kconfig
choice 
	prompt "Type of binary to build"
	default NDS_DSGBA

config NDS_DSGBA
	bool ".ds.gba"
	help
	Build a .ds.gba file for use with a GBA flash card.

config NDS_NDS
	bool ".nds"
	help
	Build a .nds file for use with emulators or wifime and a modified 
	firmware.

endchoice
```

## branches/linux_branch/linux-2.6.x/sound/arm/Kconfig
```kconfig
# ALSA ARM drivers

menu "ALSA ARM devices"
	depends on SND!=n && ARM

config SND_SA11XX_UDA1341
	tristate "SA11xx UDA1341TS driver (H3600)"
	depends on ARCH_SA1100 && SND && L3
	select SND_PCM
	help
	  Say Y or M if you have a Compaq iPaq H3x00 handheld computer and want
	  to use its Philips UDA 1341 audio chip.

config SND_NDS
	tristate "NDS sound driver"
	depends on ARCH_NDS && SND
	select SND_PCM
	help
	  Say Y or M if you have a Nintendo DS and want to use its audio chip.

endmenu
```

## branches/pixil_branch/user/pixil/apps/games/Config.in
```kconfig
menu "Nano-X Games"
depends CONFIG_NANOX

config CONFIG_GAMES
	bool "Build Nano-X games"
	default y
	help
	  Say yes here to build a number of Nano-X based
	  games.

config CONFIG_GAMES_MINESWEEP
       bool "Minsweep"
       depends CONFIG_GAMES
       default y
       help
         Say yes here to build a minesweeper clone.

config CONFIG_GAMES_SNAKE
       bool "Snake"
       depends CONFIG_GAMES
       default y
       help
         Say yes here to build a nibbles clone.

config CONFIG_GAMES_NXBILL
       bool "NXBill"
       depends CONFIG_GAMES
       default y
       help
         Say yes here to build a clone of XBill for
	 Microwindows

endmenu
```

## branches/vendor/pixil/user/pixil/packages/dvdview/Config.in
```kconfig
config CONFIG_DVDVIEW
	bool "Nano-X Video Player"
	depends CONFIG_NANOX 
	default n
```

## branches/vendor/pixil/user/pixil/packages/nxdoom/Config.in
```kconfig
config CONFIG_NXDOOM
	bool "Nano-X Doom Clone"
	depends CONFIG_NANOX 
	default n
```
