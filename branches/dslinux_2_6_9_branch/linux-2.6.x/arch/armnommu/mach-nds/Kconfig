## trunk/linux-2.6.x/drivers/input/touchscreen/Kconfig
```kconfig
#
# Mouse driver configuration
#
menuconfig INPUT_TOUCHSCREEN
	bool "Touchscreens"
	help
	  Say Y here, and a list of supported touchscreens will be displayed.
	  This option doesn't affect the kernel.

	  If unsure, say Y.

if INPUT_TOUCHSCREEN

config TOUCHSCREEN_BITSY
	tristate "Compaq iPAQ H3600 (Bitsy) touchscreen"
	depends on SA1100_BITSY
	select SERIO
	help
	  Say Y here if you have the h3600 (Bitsy) touchscreen.

	  If unsure, say N.

	  To compile this driver as a module, choose M here: the
	  module will be called h3600_ts_input.

config TOUCHSCREEN_CORGI
	tristate "SharpSL (Corgi and Spitz series) touchscreen driver"
	depends on PXA_SHARPSL
	default y	
	help
	  Say Y here to enable the driver for the touchscreen on the 
	  Sharp SL-C7xx and SL-Cxx00 series of PDAs.

	  If unsure, say N.

	  To compile this driver as a module, choose M here: the
	  module will be called corgi_ts.

config TOUCHSCREEN_GUNZE
	tristate "Gunze AHL-51S touchscreen"
	select SERIO
	help
	  Say Y here if you have the Gunze AHL-51 touchscreen connected to
	  your system.

	  If unsure, say N.

	  To compile this driver as a module, choose M here: the
	  module will be called gunze.

config TOUCHSCREEN_NDS
	tristate "Nintendo DS touchscreen"
	depends on INPUT && INPUT_TOUCHSCREEN && ARCH_NDS
	help
	  Say Y here if you are compiling the kernel for the Nintendo DS.
	  To compile this driver as a module, choose M here:  The module
	  will be called nds_ts

config TOUCHSCREEN_NDS_DEFAULT_MODE
       int "Starting mode of the driver."
       depends on INPUT && INPUT_TOUCHSCREEN && TOUCHSCREEN_NDS && ARCH_NDS
       default 1
       help
	 Determines if the driver returns absolute x/y coordinates
	 (mode 2), key codes for a keyboard (mode 1), or is currently
	 disabled (mode 0.)  When in mouse mode, the driver returns
	 the absolute position of the cursor.  When in keyboard mode,
	 the driver returns key codes based on the location that the
	 user touched.  When disabled, the driver does not generate
	 any input in response to touchscreen activity.

config TOUCHSCREEN_NDS_MAX_KEYBOARDS
       int "Maxmimum graphical keyboards"
       default 2
       depends on INPUT && INPUT_TOUCHSCREEN && TOUCHSCREEN_NDS && ARCH_NDS
       help
         The NDS Touchscreen kernel module displays a graphical
         keyboard on the touch screen when not in mouse mode.  This
         determines how many graphical keyboards (upper case vs. lower
         case for example) the module can support.  Leave the default
         of 2 unless a different type of keyboard is required.

config TOUCHSCREEN_NDS_MAX_KEYCODES
       int "Maximum keys per keyboard"
       default 128
       depends on INPUT && INPUT_TOUCHSCREEN && TOUCHSCREEN_NDS && ARCH_NDS
       help
         Determines the maximum number of keys available on the keyboard.
       
config TOUCHSCREEN_NDS_DEBUG_LEVEL
	int "Module debug level"
	range 0 3
	default 0
	depends on INPUT && INPUT_TOUCHSCREEN && TOUCHSCREEN_NDS && ARCH_NDS
	help
	  Enables debugging of the touch screen driver.  At level
	  zero, no debugging messages will appear.  Level three is
	  maximum verbosity.

config TOUCHSCREEN_ELO
	tristate "Elo serial touchscreens"
	select SERIO
	help
	  Say Y here if you have an Elo serial touchscreen connected to
	  your system.

	  If unsure, say N.

	  To compile this driver as a module, choose M here: the
	  module will be called elo.

config TOUCHSCREEN_MTOUCH
	tristate "MicroTouch serial touchscreens"
	select SERIO
	help
	  Say Y here if you have a MicroTouch (3M) serial touchscreen connected to
	  your system.

	  If unsure, say N.

	  To compile this driver as a module, choose M here: the
	  module will be called mtouch.

config TOUCHSCREEN_MK712
	tristate "ICS MicroClock MK712 touchscreen"
	help
	  Say Y here if you have the ICS MicroClock MK712 touchscreen
	  controller chip in your system.

	  If unsure, say N.

	  To compile this driver as a module, choose M here: the
	  module will be called mk712.

config TOUCHSCREEN_HP600
	tristate "HP Jornada 680/690 touchscreen"
	depends on SH_HP600 && SH_ADC
	help
	  Say Y here if you have a HP Jornada 680 or 690 and want to
          support the built-in touchscreen.

	  If unsure, say N.

	  To compile this driver as a module, choose M here: the
	  module will be called hp680_ts_input.

endif
```

## trunk/user/pixil/apps/fltk/Config.in
```kconfig
menu "FLTK Applications"

config CONFIG_FLTKAPPS
       bool "Build FLTK Applications"
       depends CONFIG_FLNX
       default y
       help
	Say 'yes' here to build the FLTK PIMs and other
	applications

config CONFIG_PIM_ADDRESS
       bool "Address Book"
       depends CONFIG_FLTKAPPS
       default y
       help
	Say 'yes' here to build the Pixil address book,
	part of the Pixil PIM suite

config CONFIG_PIM_NOTEPAD
       bool "Notepad"
        depends CONFIG_FLTKAPPS
       default y
       help
	Say 'yes' here to build the Pixil notepad,
	part of the Pixil PIM suite

config CONFIG_PIM_TODO
       bool "Todo"
       default y
        depends CONFIG_FLTKAPPS
       help
	Say 'yes' here to build the Pixil todo manager,
	part of the Pixil PIM suite

config CONFIG_PIM_SCHEDULE
       bool "Scheduler"
        depends CONFIG_FLTKAPPS
       default y
       help
	Say 'yes' here to build the Pixil scheduler,
	part of the Pixil PIM suite

config CONFIG_APP_ALARM
       bool "Alarm Deamon"
       default y
       depends on CONFIG_PIM_SCHEDULE
       help 
         Say 'yes' here to build the alarm deamon, which
	 allows you to set audible alarms through the
	 scheduler.

config CONFIG_APP_CALC
	bool "Calculator"
	        depends CONFIG_FLTKAPPS	
	default y
	help
	 Say 'yes' here to build a calculator app

config CONFIG_APP_FIND
       bool "Global Find"
        depends on CONFIG_COLOSSEUM && CONFIG_FLTKAPPS
       default y
       help
         Say 'yes' here to build the Global Find application.

config CONFIG_APP_MP3
       bool "MP3 Player"
       depends CONFIG_FLTKAPPS && CONFIG_NANOX
       default y
       help
         Say 'yes' here to build the MP3 player.

config CONFIG_MP3_USE_PTHREAD
       bool "Use pthread library"
       default y
       depends on CONFIG_APP_MP3
       help
         Say 'yes' here to build the MP3 player with threading enabled.

config CONFIG_APP_EMAIL
       bool "E-mail client"
       depends CONFIG_FLTKAPPS
       default y
       help 
         Say 'yes' here to build the Pixil e-mail client.

config CONFIG_APP_SYNC
        bool "Sync manager"
	depends CONFIG_FLTKAPPS && CONFIG_SYNC
        default y
	help 
	Say yes here to build the sync manager to handle the syncronization process.

config CONFIG_APP_NETCONFIG
 	bool "Network Configuration"
	depends CONFIG_FLTKAPPS && CONFIG_NANOX
	default y
	help
	  Say 'yes' here to build the network configuration utility.

config CONFIG_APP_SYSCONFIG
       bool "System Configuration"
       depends CONFIG_FLTKAPPS
       default y
       help
         Say 'yes' here to build the Pixil system configuration
	 utility.

source apps/fltk/sysconfig/Config.in

endmenu
```

## trunk/user/pixil/apps/fltk/sysconfig/Config.in
```kconfig
menu "Sysconfig Plugins"
depends CONFIG_APP_SYSCONFIG

config CONFIG_SYSCONF_ABOUT
       bool "About plugin"
       default y
       help
	Say 'yes' here to build the about plugin for
	the system configuration utility.  The about
	plugin describes the current system settings.


config CONFIG_SYSCONF_BACKLITE
       bool "Backlite plugin"
       default y
       depends CONFIG_PM
       help
	Say 'yes' here to build the backlite plugin for
	the system configuration utility.   The backlite
	plugin allows the user to set brightness and 
	screen settings.

#config CONFIG_SYSCONF_CAL
#       bool "Calibration plugin"
#       default y
#       depends on CONFIG_NANOX 
#       help
#	Say 'yes' here to build the calibration plugin for
#	the system configuration utility. The calibration
#	plugin allows the user to readjust the mouse settings.

config CONFIG_SYSCONF_CLOCK
       bool "CLock plugin"
       default y
       help
	Say 'yes' here to build the clock plugin for
	the system configuration utility. The clock
	plugin allows the user to set the current date
	and time.

config CONFIG_SYSCONF_MEMORY
       bool "Memory plugin"
       default y
       help
	Say 'yes' here to build the memory plugin for
	the system configuration utility. The memory
	plugin allows the user to review the current
	memory and flash usage.

config CONFIG_SYSCONF_POWER
       bool "Power plugin"
       default y
       depends CONFIG_PM
       help
	Say 'yes' here to build the power plugin for
	the system configuration utility.  The power
	plugin allows the user to review power settings
	to conserve battery space.

config CONFIG_SYSCONF_REGIONAL
       bool "Regional plugin"
       default y
       help
	Say 'yes' here to build the reginal plugin for
	the system configuration utility.  The regional
	plugin allows the user to set regional preferences
	based on their preferred country.

config CONFIG_SYSCONF_USERINFO
       bool "User Info plugin"
       default y
       help
	Say 'yes' here to build the user info plugin for
	the system configuration utility.  The user info
	plugin allows the user to set personal information
	(name, e-mail, etc..).

endmenu
```

## trunk/user/pixil/sys/Config.in
```kconfig
menu "System Applications"

config CONFIG_COLOSSEUM
       bool "IPC server"
       default y
       help
        Colosseum is the Pixil Inter Process Communications server.
	It is used to allow easier data sharing between applications.
	You probably want to say 'Y' here.

config CONFIG_PAR
       bool "Pixil Application Registry"
       default y
       help
       the Pixil Application Registry (PAR) is used to store application
       information and configuration information.  It is used by the window
       manager and all the applications as a central despository for data.
       You will want to say 'Y' here unless you absolutely know what you are doing.

config CONFIG_PIXILWM
	bool "Pixil Window Manager"
	depends on CONFIG_NANOX
	default y
	help
	Say 'yes' here to build the Pixil Window Manager - a majpr part of the 
	Pixil Operating Environment under Nano-X.

config CONFIG_PIXILWM_THEMES
       bool "Enable PixilWM themes"
       depends on CONFIG_PIXILWM
       default y
       help
       Say yes here to enable the PixilWM themes engine

config CONFIG_PIXILWM_MENUS
       bool "Enable PixilWM system menus"
       depends on CONFIG_PIXILWM
       default y
       help
       Say yes here to enable the PixilWM system menus

config CONFIG_PIXILWM_PM
       bool
       depends on CONFIG_PIXILWM && CONFIG_PM
       default y

endmenu
```

## user/pixil/apps/Config.in
```kconfig
menu "Applications"

source apps/nanox/Config.in
source apps/games/Config.in
source apps/fltk/Config.in

endmenu
```

## user/pixil/apps/nanox/Config.in
```kconfig
menu "Nano-X Applications"
depends CONFIG_NANOX

config CONFIG_NXAPPS
       bool "Build Nano-X Applications"
       default y
       help
       Say yes here to build the Nano-X applications

config CONFIG_NANOX_APPS
       bool "Nano-X Utilities"
       depends CONFIG_NXAPPS
       default y

config CONFIG_NANOX_DVDVIEW
       bool "DVDView for Nano-X"
       depends CONFIG_NXAPPS 
       default y
       help
       Say yes here to build DVDView for Nano-X to watch movies.

config CONFIG_NANOX_WCLOCK
       bool "Nano-X World Clock"
       depends CONFIG_NXAPPS
       default y
       
menu "Nano-X Input Methods"
depends CONFIG_NXAPPS
       
config CONFIG_NANOX_KEYBOARD
       bool "Keyboard"
       default y
       help
       Say yes here to build the Nano-X keyboard input method

config CONFIG_NANOX_SCRIBBLE
       bool "Scribble"
       default y
       help
       Say yes here to build the Nano-X scribble application

endmenu
endmenu
```

## user/pixil/scripts/platforms/Config.in
```kconfig
menu "Platform Configuration"

choice
	prompt "Build Platform"
	default "Native X86 Demo"
	help
	  Select the desired build platform.  Among other things
	  this will install default scripts and other information.

config CONFIG_PLATFORM_IPAQ
	bool "Compaq Ipaq"

config CONFIG_PLATFORM_ZAURUS
       bool "Sharp Zaurus"

config CONFIG_PLATFORM_TUXSCREEN
       bool "Tuxscreen"

config CONFIG_PLATFORM_X86DEMO
       bool" Desktop"

config CONFIG_PLATFORM_DSLINUX
       bool" DSLinux"

endchoice

config CONFIG_CPU_STRONGARM
       bool
       depends CONFIG_PLATFORM_IPAQ || CONFIG_PLATFORM_ZAURUS || CONFIG_PLATFORM_TUXSCREEN
       default y

config CONFIG_CPU_INTEL
       bool
       depends CONFIG_PLATFORM_X86DEMO 
       default y

config CONFIG_CPU_ARM
       bool
       depends CONFIG_PLATFORM_DSLINUX
       default y

endmenu
```
