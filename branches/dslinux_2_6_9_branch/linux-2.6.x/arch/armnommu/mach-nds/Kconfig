## user/pixil/scripts/sysdep/Config.in
```kconfig
#
# For a description of the syntax of this configuration file,
# see scripts/kbuild/config-language.txt.
#

mainmenu "Pixil Configuration"

config HAVE_DOT_CONFIG
	bool
	default y

menu "General Configuration"

choice
	prompt "Graphical Engine"
	default "Microwindows"
	help
	  Pixil can be build for either Nano-X (Microwindows) or X11.
	  Using Nano-X will result in significantly smaller binaries.

config CONFIG_X11
       bool "X11"

config CONFIG_NANOX
       bool "Microwindows"

endchoice

endmenu

source scripts/platforms/Config.in

menu "Build Options"

config COMPILE_CROSS
	bool "Do you want to build Pixil with a cross compiler?"
	default n
	help
	  Enable this option to build Pixil with a cross compiler.

choice
	prompt "Target Platform"
	default "Strongarm"
	depends COMPILE_CROSS
	help
	  Select the target platform for this code 

config CONFIG_TARGET_ARM
       bool "StrongARM"

config CONFIG_TARGET_I386_UCLIBC
       bool "i386 uClibc

endchoice

config CROSS_COMPILER_PREFIX
	string "Cross compiler prefix"
	default "/usr/local/arm/bin/arm-linux-"
	depends COMPILE_CROSS
	help
	  If you want to build Pixil with a cross compiler, then you 
	  will need to set this to the cross-compiler prefix.  For example,
	  if my cross-compiler is /usr/local/arm/bin/arm-linux-gcc, 
	  then I would enter /usr/local/arm/bin/arm-linux- here,
	  which will ensure the correct compiler is used.

config MW_PREFIX
        string "Microwindows prefix"
	default "/usr/local/microwin/src/"
	depends on CONFIG_NANOX
	help
	  If you choose to use Microwindows, you need to specify where
	  the Microwindows libraries are located.  Remember to specify
	  the right tree for the compiler you are building for.

config CONFIG_FLNX
       bool "Build FLNX"
       default y
       help
	Say yes here to build FLNX for Microwindows or X11

config CONFIG_FLNX_PDA
	bool "Enable FLNX 2D widgets"
	default y
	depends on CONFIG_FLNX
	help
	Say yes here to enable the 2D drawing code in the 
	FLNX package

config CONFIG_FLEK
	bool "Build FLEK"
	default y
	depends on CONFIG_FLNX
	help
	Say yes here to build FLEK for Microwindows or X11

config CONFIG_DEBUG
	bool "Build Pixil with debugging symbols"
	default n
	help
	  Say Y here if you wish to compile Pixil with debugging symbols.
	  This increases the size of the binary 
	  considerably and should only be used when doing development.

endmenu

menu "Installation Options"

config INSTALL_PREFIX
       string "Pixil install prefix"
       default "/usr/local/pixil/"
       help
         Indicate where Pixil should be installed when it is built

config TARGET_PREFIX
       string "Pixil target prefix"
       default "/usr/local/pixil/"
       help
         Indicate where Pixil should be run in the target

config CONFIG_SAMPLES
	bool "Install sample data?"
	default y
	help
	  Install sample data for the Pixil applications

endmenu

menu "Global Options"

config CONFIG_PM
       bool "Enable power management support"
       default y
       help
       Enable support for power managment

config CONFIG_SYNC
	bool "Enable Sync support"
	default y
	depends CONFIG_COLOSSEUM
	help
	Build all the nessesary components for the sync engine
endmenu

source sys/Config.in
source apps/Config.in
source packages/Config.in
source pixilDT/Config.in
```
