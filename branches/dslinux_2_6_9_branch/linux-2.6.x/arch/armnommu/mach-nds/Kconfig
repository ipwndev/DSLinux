## trunk/linux-2.6.x/arch/armnommu/Kconfig
```kconfig
# For a description of the syntax of this configuration file,
# see Documentation/kbuild/kconfig-language.txt.
#

mainmenu "uClinux/ARM (w/o MMU) Kernel Configuration"

config ARM
	bool
	default y
config UCLINUX
	bool
	default y
	help
	  uClinux is the MMU-less version of Linux Kernel.

	  The ARM series is a line of low-power-consumption RISC chip designs
	  licensed by ARM ltd and targeted at embedded applications and
	  handhelds such as the Compaq IPAQ.  ARM-based PCs are no longer
	  manufactured, but  legacy ARM-based PC hardware remains popular in
	  Europe.

	  There is an ARM(w/MMU) Linux project with a web page at
	  <http://www.arm.linux.org.uk/>.

	  The recent cores are designed to address a wide variety of applications.
	  Many cores for application platform have Memory Mangement Unit(MMU),
	  however, other cores for embedded systems, secure application have
	  only MPU or even NONE, although heavily used in many SoCs.

	  There is an ARM(w/o MMU) uClinux project with a web page at
	  <http://adam.kaist.ac.kr/~hschoe/>.

config MMU
	bool
	default n
	help
	  We don't use paged MMU here. 

config MPU
	bool
	help
	  Some cores of ARM series have Memory Processing Unit(MPU).
	  Refer your core manual.

	  Say Y here if your ARM core has MPU.

	  Otherwise, say N.

config EISA
	bool
	---help---
	  The Extended Industry Standard Architecture (EISA) bus was
	  developed as an open alternative to the IBM MicroChannel bus.

	  The EISA bus provided some of the features of the IBM MicroChannel
	  bus while maintaining backward compatibility with cards made for
	  the older ISA bus.  The EISA bus saw limited use between 1988 and
	  1995 when it was made obsolete by the PCI bus.

	  Say Y here if you are building a kernel for an EISA-based machine.

	  Otherwise, say N.

config SBUS
	bool

config MCA
	bool
	help
	  MicroChannel Architecture is found in some IBM PS/2 machines and
	  laptops.  It is a bus system similar to PCI or ISA. See
	  <file:Documentation/mca.txt> (and especially the web page given
	  there) before attempting to build an MCA bus kernel.

config UID16
	bool
	default y

config RWSEM_GENERIC_SPINLOCK
	bool
	default y

config RWSEM_XCHGADD_ALGORITHM
	bool

config GENERIC_BUST_SPINLOCK
	bool

config GENERIC_ISA_DMA
	bool

source "init/Kconfig"


menu "System Type"

choice
	prompt "ARM system type"
	default ARCH_S3C3410

config ARCH_ATMEL
	bool "Atmel AT91xxx"
	help
	  The AT91xxx Series is a subset of the Atmel AT91 16/32-bit
	  microcontroller family, which is based on the ARM7TDMI
	  processor core.
	  refer <http://www.atmel.com>

	  You can also choose this architecture for The GDB/Armulator.
	  It emulates AT91F40, include ARM7TDMI core and timers/serial.
	  refer <http://www.uclinux.org/pub/uClinux/utilities/armulator/>.

config ARCH_S3C3410
	bool "Samsung S3C3410X"
	help
	  Samsung's S3C3410X(KS17C40100) 16/32-bit RISC MCU
	  is a cost-effective and high-performance MCU solution for PDA and
	  general purpose application. The core is ARM7TDMI. 
	  
	  refer <http://www.samsungsemi.com>.

config ARCH_ESPD_4510B
	bool "ESPD 4510B / Samsung S3C4510B"
	help
	  ESPD 4510B evaluation board built on Samsung's
	  S3C4510B(KS32C50100) 16/32-bit RISC MCU
	  is a high performance network controller based
	  on the ARM7TDMI core.
	  
	  refer to  <http://www.espd-inc.com/prod01-arm-samsung4510.htm>

config ARCH_S3C44B0
	bool "Samsung S3C44B0"
	help
	  Samsung's S3C44B0X 16/32-bit SOC(ARM7TDMI) without coprocessor 
 
config ARCH_S5C7375
	bool "Samsung S5C7375"
	help
	  Samsung's S5C7375 16/32-bit SOC(ARM920T) for internal use.

config ARCH_S3C24A0 
	bool "Samsung S3C24A0" 
	help 
	  Samsung's S3C24A0 media processor based on ARM926EJ core. 

config ARCH_P2001
	bool "P2001"
	help
	  The LPEC P2001 evaluation board has an P2001 processor from
	  MAZ Brandenburg GmbH, which is based an ARM9TDMI processor core.

config ARCH_NDS
	bool "Nintendo DS"
	help
	  The Nintendo DS.

endchoice

config SET_MEM_PARAM
	bool "Set flash/sdram size and base addr"
	help
	 Say Y to manually set the base addresses and sizes.
	 otherwise, the default values are assigned.

config DRAM_BASE
	hex '(S)DRAM Base Address' if SET_MEM_PARAM
	default 0x01000000 if ARCH_ATMEL
	default 0x01000000 if ARCH_S3C3410
	default 0x0C000000 if ARCH_S3C44B0
	default 0x00000000 if ARCH_S5C7375
	default 0x00000000 if ARCH_ESPD_4510B
	default 0x10000000 if ARCH_S3C24A0 
	default 0x02000000 if ARCH_NDS
	default 0x00800000

config DRAM_SIZE
	hex '(S)DRAM SIZE' if SET_MEM_PARAM
	default 0x00600000 if ARCH_ATMEL
	default 0x01000000 if ARCH_S3C3410
	default 0x01000000 if ARCH_S3C44B0
	default 0x00400000 if ARCH_S5C7375
	default 0x00800000 if ARCH_ESPD_4510B
	default 0x04000000 if ARCH_S3C24A0 
	default 0x00400000 if ARCH_NDS
	default 0x00800000

config FLASH_MEM_BASE
	hex 'FLASH Base Address' if SET_MEM_PARAM
	default 0x01600000 if ARCH_ATMEL
	default 0x00000000 if ARCH_S3C3410
	default 0x00000000 if ARCH_S3C44B0
	default 0x08000000 if ARCH_S5C7375
	default 0x08000000 if ARCH_NDS
	default 0x01000000 if ARCH_ESPD_4510B
	default 0x00400000

config FLASH_SIZE
	hex 'FLASH Size' if SET_MEM_PARAM
	default 0x00200000 if ARCH_ATMEL
	default 0x00200000 if ARCH_S3C3410
	default 0x00200000 if ARCH_S3C44B0
	default 0x00200000 if ARCH_S5C7375
	default 0x00200000 if ARCH_ESPD_4510B
	default 0x00400000

source "arch/armnommu/mach-atmel/Kconfig"
source "arch/armnommu/mach-s3c3410/Kconfig"
source "arch/armnommu/mach-s3c44b0x/Kconfig"
source "arch/armnommu/mach-s5c7375/Kconfig"
source "arch/armnommu/mach-espd_4510b/Kconfig"
source "arch/armnommu/mach-s3c24a0/Kconfig" 
source "arch/armnommu/mach-nds/Kconfig" 
source arch/armnommu/mm/Kconfig

endmenu


menu "General setup"

# Now handle the bus types
config PCI
	bool "PCI support"
	default n
	help
	  Find out whether you have a PCI motherboard. PCI is the name of a
	  bus system, i.e. the way the CPU talks to the other stuff inside
	  your box. Other bus systems are ISA, EISA, MicroChannel (MCA) or
	  VESA. If you have PCI, say Y, otherwise N.

	  The PCI-HOWTO, available from
	  <http://www.tldp.org/docs.html#howto>, contains valuable
	  information about which PCI hardware does work under Linux and which
	  doesn't.

# Select the host bridge type
config ARM_AMBA
	bool
	depends on ARCH_S5C7375
	default y

config ISA
	bool
	default n
	help
	  Find out whether you have ISA slots on your motherboard.  ISA is the
	  name of a bus system, i.e. the way the CPU talks to the other stuff
	  inside your box.  Other bus systems are PCI, EISA, MicroChannel
	  (MCA) or VESA.  ISA is an older system, now being displaced by PCI;
	  newer boards don't support it.  If you have ISA, say Y, otherwise N.

config ISA_DMA
	bool
	default n

config FIQ
	bool
	default n

# Compressed boot loader in ROM.  Yes, we really want to ask about
# TEXT and BSS so we preserve their values in the config files.
config ZBOOT_ROM
	bool "Compressed boot loader in ROM/flash"
	help
	  Say Y here if you intend to execute your compressed kernel image (zImage)
	  directly from ROM or flash.  If unsure, say N.

config ZBOOT_ROM_TEXT
	hex "Compressed ROM boot loader base address"
	default "0"
	help
	  The base address for zImage.  Unless you have special requirements, you
	  should not change this value.

config ZBOOT_ROM_BSS
	hex "Compressed ROM boot loader BSS address"
	default "0"
	help
	  The base address of 64KB of read/write memory, which must be available
	  while the decompressor is running.  Unless you have special requirements,
	  you should not change this value.

config CPU_FREQ
	bool "Support CPU clock change (EXPERIMENTAL)"
	depends on (ARCH_S5C7375) && EXPERIMENTAL
	help
	  CPU clock scaling allows you to change the clock speed of the
	  running CPU on the fly. This is a nice method to save battery power,
	  because the lower the clock speed, the less power the CPU
	  consumes. Note that this driver doesn't automatically change the CPU
	  clock speed, you need some userland tools (which still have to be
	  written) to implement the policy. If you don't understand what this
	  is all about, it's safe to say 'N'.


source "drivers/pci/Kconfig"

source "drivers/pcmcia/Kconfig"

comment "At least one math emulation must be selected"

config FPE_NWFPE
	bool "NWFPE math emulation"
	---help---
	  Say Y to include the NWFPE floating point emulator in the kernel.
	  This is necessary to run most binaries. Linux does not currently
	  support floating point hardware so you need to say Y here even if
	  your machine has an FPA or floating point co-processor podule.

	  You may say N here if you are going to load the Acorn FPEmulator
	  early in the bootup.

config FPE_NWFPE_XP
	bool "Support extended precision"
	depends on FPE_NWFPE
	help
	  Say Y to include 80-bit support in the kernel floating-point
	  emulator.  Otherwise, only 32 and 64-bit support is compiled in.
	  Note that gcc does not generate 80-bit operations by default,
	  so in most cases this option only enlarges the size of the
	  floating point emulator without any good reason.

	  You almost surely want to say N here.

config FPE_FASTFPE
	bool "FastFPE math emulation (EXPERIMENTAL)"
	depends on !CPU_32v3 && EXPERIMENTAL
	---help---
	  Say Y here to include the FAST floating point emulator in the kernel.
	  This is an experimental much faster emulator which now also has full
	  precision for the mantissa.  It does not support any exceptions.
	  It is very simple, and approximately 3-6 times faster than NWFPE.

	  It should be sufficient for most programs.  It may be not suitable
	  for scientific calculations, but you have to check this for yourself.
	  If you do not feel you need a faster FP emulation you should better
	  choose NWFPE.

source "fs/Kconfig.binfmt"

source "drivers/base/Kconfig"

config PM
	bool "Power Management support"
	---help---
	  "Power Management" means that parts of your computer are shut
	  off or put into a power conserving "sleep" mode if they are not
	  being used.  There are two competing standards for doing this: APM
	  and ACPI.  If you want to use either one, say Y here and then also
	  to the requisite support below.

	  Power Management is most important for battery powered laptop
	  computers; if you have a laptop, check out the Linux Laptop home
	  page on the WWW at <http://www.linux-on-laptops.com/> or
	  Tuxmobil - Linux on Mobile Computers at <http://www.tuxmobil.org/>
	  and the Battery Powered Linux mini-HOWTO, available from
	  <http://www.tldp.org/docs.html#howto>.

	  Note that, even if you say N here, Linux on the x86 architecture
	  will issue the hlt instruction if nothing is to be done, thereby
	  sending the processor to sleep and saving power.

config PREEMPT
	bool "Preemptible Kernel (EXPERIMENTAL)"
	depends on CPU_32 && EXPERIMENTAL
	help
	  This option reduces the latency of the kernel when reacting to
	  real-time or interactive events by allowing a low priority process to
	  be preempted even if it is in kernel mode executing a system call.
	  This allows applications to run more reliably even when the system is
	  under load.

	  Say Y here if you are building a kernel for a desktop, embedded
	  or real-time system.  Say N if you are unsure.

config APM
	tristate "Advanced Power Management Emulation"
	depends on PM
	---help---
	  APM is a BIOS specification for saving power using several different
	  techniques. This is mostly useful for battery powered laptops with
	  APM compliant BIOSes. If you say Y here, the system time will be
	  reset after a RESUME operation, the /proc/apm device will provide
	  battery status information, and user-space programs will receive
	  notification of APM "events" (e.g. battery status change).

	  If you select "Y" here, you can disable actual use of the APM
	  BIOS by passing the "apm=off" option to the kernel at boot time.

	  Note that the APM support is almost completely disabled for
	  machines with more than one CPU.

	  In order to use APM, you will need supporting software. For location
	  and more information, read <file:Documentation/pm.txt> and the
	  Battery Powered Linux mini-HOWTO, available from
	  <http://www.tldp.org/docs.html#howto>.

	  This driver does not spin down disk drives (see the hdparm(8)
	  manpage ("man 8 hdparm") for that), and it doesn't turn off
	  VESA-compliant "green" monitors.

	  This driver does not support the TI 4000M TravelMate and the ACER
	  486/DX4/75 because they don't have compliant BIOSes. Many "green"
	  desktop machines also don't have compliant BIOSes, and this driver
	  may cause those machines to panic during the boot phase.

	  Generally, if you don't have a battery in your machine, there isn't
	  much point in using this driver and you should say N. If you get
	  random kernel OOPSes or reboots that don't seem to be related to
	  anything, try disabling/enabling this option (or disabling/enabling
	  APM in your BIOS).

	  Some other things you should try when experiencing seemingly random,
	  "weird" problems:

	  1) make sure that you have enough swap space and that it is
	  enabled.
	  2) pass the "no-hlt" option to the kernel
	  3) switch on floating point emulation in the kernel and pass
	  the "no387" option to the kernel
	  4) pass the "floppy=nodma" option to the kernel
	  5) pass the "mem=4M" option to the kernel (thereby disabling
	  all but the first 4 MB of RAM)
	  6) make sure that the CPU is not over clocked.
	  7) read the sig11 FAQ at <http://www.bitwizard.nl/sig11/>
	  8) disable the cache from your BIOS settings
	  9) install a fan for the video card or exchange video RAM
	  10) install a better fan for the CPU
	  11) exchange RAM chips
	  12) exchange the motherboard.

	  To compile this driver as a module, choose M here: the
	  module will be called apm.

config CMDLINE
	string "Default kernel command string"
	default ""
	help
	  On some architectures (EBSA110 and CATS), there is currently no way
	  for the boot loader to pass arguments to the kernel. For these
	  architectures, you should supply some command-line options at build
	  time by entering them here. As a minimum, you should specify the
	  memory size and the root device (e.g., mem=64M root=/dev/nfs).

config LEDS
	bool "Timer and CPU usage LEDs"
	depends on ARCH_S5C7375
	help
	  If you say Y here, the LEDs on your machine will be used
	  to provide useful information about your current system status.

	  If you are compiling a kernel for a NetWinder or EBSA-285, you will
	  be able to select which LEDs are active using the options below. If
	  you are compiling a kernel for the EBSA-110 or the LART however, the
	  red LED will simply flash regularly to indicate that the system is
	  still functional. It is safe to say Y here if you have a CATS
	  system, but the driver will do nothing.

config LEDS_TIMER
	bool "Timer LED" if LEDS && ARCH_S5C7375
	depends on ARCH_S5C7375
	help
	  If you say Y here, one of the system LEDs (the green one on the
	  NetWinder, the amber one on the EBSA285, or the red one on the LART)
	  will flash regularly to indicate that the system is still
	  operational. This is mainly useful to kernel hackers who are
	  debugging unstable kernels.

	  The LART uses the same LED for both Timer LED and CPU usage LED
	  functions. You may choose to use both, but the Timer LED function
	  will overrule the CPU usage LED.

config LEDS_CPU
	bool "CPU usage LED"
	depends on LEDS && ARCH_S5C7375
	help
	  If you say Y here, the red LED will be used to give a good real
	  time indication of CPU usage, by lighting whenever the idle task
	  is not currently executing.

	  The LART uses the same LED for both Timer LED and CPU usage LED
	  functions. You may choose to use both, but the Timer LED function
	  will overrule the CPU usage LED.

config ALIGNMENT_TRAP
	bool "Kernel-mode alignment trap handler"
	depends on CPU_32
	default n if ARCH_S3C3410 || ARCH_ATMEL || ARCH_ESPD_4510B
	help
	  ARM processors can not fetch/store information which is not
	  naturally aligned on the bus, i.e., a 4 byte fetch must start at an
	  address divisible by 4. On 32-bit ARM processors, these non-aligned
	  fetch/store instructions will be emulated in software if you say
	  here, which has a severe performance impact. This is necessary for
	  correct operation of some network protocols. With an IP-only
	  configuration it is safe to say N, otherwise say Y.

endmenu

source "drivers/parport/Kconfig"

if ALIGNMENT_TRAP
source "drivers/mtd/Kconfig"
endif

source "drivers/pnp/Kconfig"

source "drivers/block/Kconfig"

source "drivers/md/Kconfig"

source "net/Kconfig"

source "drivers/ide/Kconfig"

source "drivers/scsi/Kconfig"

source "drivers/message/fusion/Kconfig"

source "drivers/ieee1394/Kconfig"

source "drivers/message/i2o/Kconfig"

source "drivers/isdn/Kconfig"

#
# input before char - char/joystick depends on it. As does USB.
#
source "drivers/input/Kconfig"

source "drivers/char/Kconfig"

source "drivers/i2c/Kconfig"

#source "drivers/l3/Kconfig"

source "drivers/media/Kconfig"

source "fs/Kconfig"

source "drivers/video/Kconfig"

source "sound/Kconfig"

source "drivers/misc/Kconfig"

source "drivers/usb/Kconfig"


menu "Kernel hacking"

# RMK wants arm kernels compiled with frame pointers so hardwire this to y.
# If you know what you are doing and are willing to live without stack
# traces, you can get a slightly smaller kernel by setting this option to
# n, but then RMK will have to kill you ;).
config FRAME_POINTER
	bool "Frame Pointer"
	default y
	help
	  If you say N here, the resulting kernel will be slightly smaller and
	  faster. However, when a problem occurs with the kernel, the
	  information that is reported is severely limited. Most people
	  should say Y here.

config DEBUG_USER
	bool "Verbose user fault messages"
	help
	  When a user program crashes due to an exception, the kernel can
	  print a brief message explaining what the problem was. This is
	  sometimes helpful for debugging but serves no purpose on a
	  production system. Most people should say N here.

config DEBUG_INFO
	bool "Include GDB debugging information in kernel binary"
	help
	  Say Y here to include source-level debugging information in the
	  `vmlinux' binary image. This is handy if you want to use gdb or
	  addr2line to debug the kernel. It has no impact on the in-memory
	  footprint of the running kernel but it can increase the amount of
	  time and disk space needed for compilation of the kernel. If in
	  doubt say N.

config DEBUG_KERNEL
	bool "Kernel debugging"
	help
	  Say Y here if you are developing drivers or trying to debug and
	  identify kernel problems.

config DEBUG_SLAB
	bool "Debug memory allocations"
	depends on DEBUG_KERNEL
	help
	  Say Y here to have the kernel do limited verification on memory
	  allocation as well as poisoning memory on free to catch use of freed
	  memory.

config MAGIC_SYSRQ
	bool "Magic SysRq key"
	depends on DEBUG_KERNEL
	help
	  If you say Y here, you will have some control over the system even
	  if the system crashes for example during kernel debugging (e.g., you
	  will be able to flush the buffer cache to disk, reboot the system
	  immediately or dump some status information). This is accomplished
	  by pressing various keys while holding SysRq (Alt+PrintScreen). It
	  also works on a serial console (on PC hardware at least), if you
	  send a BREAK and then within 5 seconds a command keypress. The
	  keys are documented in <file:Documentation/sysrq.txt>. Don't say Y
	  unless you really know what this hack does.

config DEBUG_SPINLOCK
	bool "Spinlock debugging"
	depends on DEBUG_KERNEL
	help
	  Say Y here and build SMP to catch missing spinlock initialization
	  and certain other kinds of spinlock errors commonly made.  This is
	  best used in conjunction with the NMI watchdog so that spinlock
	  deadlocks are also debuggable.

config DEBUG_WAITQ
	bool "Wait queue debugging"
	depends on DEBUG_KERNEL

config DEBUG_BUGVERBOSE
	bool "Verbose BUG() reporting (adds 70K)"
	depends on DEBUG_KERNEL
	help
	  Say Y here to make BUG() panics output the file name and line number
	  of the BUG call as well as the EIP and oops trace.  This aids
	  debugging but costs about 70-100K of memory.

config DEBUG_ERRORS
	bool "Verbose kernel error messages"
	depends on DEBUG_KERNEL
	help
	  This option controls verbose debugging information which can be
	  printed when the kernel detects an internal error. This debugging
	  information is useful to kernel hackers when tracking down problems,
	  but mostly meaningless to other people. It's safe to say Y unless
	  you are concerned with the code size or don't want to see these
	  messages.

# These options are only for real kernel hackers who want to get their hands dirty. 
config DEBUG_LL
	bool "Kernel low-level debugging functions"
	depends on DEBUG_KERNEL
	help
	  Say Y here to include definitions of printascii, printchar, printhex
	  in the kernel.  This is helpful if you are debugging code that
	  executes before the console is initialized.

endmenu

source "security/Kconfig"

source "crypto/Kconfig"

source "lib/Kconfig"
```
